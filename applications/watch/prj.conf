## prj.conf
```kconfig
CONFIG_FIREFLY_SUBSYS_BASE=y
CONFIG_FIREFLY_SUBSYS_BASE_I2C_BITBANG=y

CONFIG_NEWLIB_LIBC=y
CONFIG_NEWLIB_LIBC_FLOAT_PRINTF=y
```

## src/fd_watch_screen_powering_off.c
```c
#include "fd_watch_screen_powering_off.h"

#include "fd_watch.h"

#include "fd_drawing_image.h"
#include "fd_drawing_text.h"
#include "fd_font_b612_regular_6.h"

#include "fd_assert.h"
#include "fd_unused.h"

#include <stdio.h>
#include <string.h>

typedef struct {
    fd_drawing_text_t text;
    fd_drawing_text_t countdown;
    fd_drawing_t drawings[2];
    fd_drawing_plane_t plane;
    
    char countdown_buffer[16];
    uint32_t ticks;
} fd_watch_screen_powering_off_t;

fd_watch_screen_powering_off_t fd_watch_screen_powering_off;

void fd_watch_screen_powering_off_add_drawing(void *object, fd_drawing_class_t *class) {
    const size_t size = sizeof(fd_watch_screen_powering_off.drawings) /  sizeof(fd_watch_screen_powering_off.drawings[0]);
    if (fd_watch_screen_powering_off.plane.drawing_count >= size) {
        fd_assert_fail("too many drawings");
        return;
    }
    fd_watch_screen_powering_off.drawings[fd_watch_screen_powering_off.plane.drawing_count] = (fd_drawing_t) { .object = object, .class =  class };
    ++fd_watch_screen_powering_off.plane.drawing_count;
}

bool fd_watch_screen_powering_off_animate(void) {
    if (fd_watch_screen_powering_off.ticks++ < (5 * 50)) {
        uint32_t countdown = 5 - fd_watch_screen_powering_off.ticks / 50;
        char buffer[16];
        snprintf(buffer, sizeof(buffer), "%u", countdown);
        fd_view_string_update(&fd_watch_screen_powering_off.countdown.view.string, buffer);
    } else {
        fd_watch_power_off();
    }

    return false;
}

void fd_watch_screen_powering_off_preview(void) {
}

void fd_watch_screen_powering_off_activate(void) {
    fd_watch_screen_powering_off.ticks = 0;
}

void fd_watch_screen_powering_off_deactivate(void) {
}

bool fd_watch_screen_powering_off_button(const fd_ux_button_event_t *event) {
    if (fd_ux_button_is_any_activated(event, fd_watch_button_both)) {
        fd_ux_set_screen(fd_watch_screen_id_time);
    }
    return false;
}

void fd_watch_screen_powering_off_initialize(fd_ux_screen_t *screen) {
    memset(&fd_watch_screen_powering_off, 0, sizeof(fd_watch_screen_powering_off));
    
    fd_drawing_plane_t *plane = &fd_watch_screen_powering_off.plane;
    plane->drawings = fd_watch_screen_powering_off.drawings;
    screen->planes[0] = plane;
    screen->plane_count = 1;
    screen->preview = fd_watch_screen_powering_off_preview;
    screen->activate = fd_watch_screen_powering_off_activate;
    screen->deactivate = fd_watch_screen_powering_off_deactivate;
    screen->button = fd_watch_screen_powering_off_button;
    screen->animate = fd_watch_screen_powering_off_animate;
    
    fd_watch_screen_powering_off.text.view = (fd_view_text_t) {
        .visible = true,
        .location = { .x = 64, .y = 64 },
        .alignments = { .x = fd_view_alignment_center, .y = fd_view_alignment_center },
        .string = { .string = "Powering Off", .length = 12 },
        .font.font = &fd_font_b612_regular_6,
        .color = { .argb = 0xffffffff },
    };
    fd_watch_screen_powering_off_add_drawing(&fd_watch_screen_powering_off.text, &fd_drawing_text_class);
    
    strncpy(fd_watch_screen_powering_off.countdown_buffer, "5", sizeof(fd_watch_screen_powering_off.countdown_buffer));
    fd_watch_screen_powering_off.countdown.view = (fd_view_text_t) {
        .visible = true,
        .location = { .x = 64, .y = 96 },
        .alignments = { .x = fd_view_alignment_center, .y = fd_view_alignment_center },
        .string = { .string = fd_watch_screen_powering_off.countdown_buffer, .length = 1 },
        .font.font = &fd_font_b612_regular_6,
        .color = { .argb = 0xffffffff },
    };
    fd_watch_screen_powering_off_add_drawing(&fd_watch_screen_powering_off.countdown, &fd_drawing_text_class);
}
```

## src/fd_watch_screen_time.c
```c
#include "fd_watch_screen_time.h"

#include "fd_watch.h"

#include "fd_drawing_text.h"
#include "fd_font_b612_regular_6.h"

#include "fd_assert.h"
#include "fd_calendar.h"
#include "fd_unused.h"

#include <stdio.h>
#include <string.h>

typedef struct {
    fd_drawing_text_t text;
    fd_drawing_t drawings[1];
    fd_drawing_plane_t plane;
    char time_string[16];
} fd_watch_screen_time_t;

fd_watch_screen_time_t fd_watch_screen_time;

void fd_watch_screen_time_add_drawing(void *object, fd_drawing_class_t *class) {
    const size_t size = sizeof(fd_watch_screen_time.drawings) /  sizeof(fd_watch_screen_time.drawings[0]);
    if (fd_watch_screen_time.plane.drawing_count >= size) {
        fd_assert_fail("too many drawings");
        return;
    }
    fd_watch_screen_time.drawings[fd_watch_screen_time.plane.drawing_count] = (fd_drawing_t) { .object = object, .class =  class };
    ++fd_watch_screen_time.plane.drawing_count;
}

int64_t fd_rtc_get_utc(void) {
    return 978307200;
}

#define UTC_2001 978307200

void fd_watch_screen_time_update(void) {
    // preferences
    int32_t utc_offset = -5 * 60 * 60;
    bool is_12_hour = true;

    int64_t utc = fd_rtc_get_utc();
    fd_calendar_t calendar = fd_calendar_from_time((utc < UTC_2001) ? utc : (utc + utc_offset));
    fd_calendar_12_hour_t clock_12_hour = fd_calendar_get_12_hour(&calendar);
    char buffer[16];
    if (is_12_hour) {
        snprintf(buffer, sizeof(buffer), "%u:%02u:%02u %cm", clock_12_hour.hour, calendar.min, calendar.sec, clock_12_hour.meridiem);
    } else {
        snprintf(buffer, sizeof(buffer), "%02u:%02u:%02u", calendar.hour, calendar.min, calendar.sec);
    }
    fd_view_string_update(&fd_watch_screen_time.text.view.string, buffer);
}

bool fd_watch_screen_time_animate(void) {
    fd_watch_screen_time_update();
    return false;
}

void fd_watch_screen_time_preview(void) {
}

void fd_watch_screen_time_activate(void) {
}

void fd_watch_screen_time_deactivate(void) {
}

bool fd_watch_screen_time_button(const fd_ux_button_event_t *event) {
    if (fd_ux_button_is_one_activated(event, fd_watch_button_left)) {
        fd_ux_set_screen(fd_watch_screen_id_splash);
    }
    return false;
}

void fd_watch_screen_time_initialize(fd_ux_screen_t *screen) {
    memset(&fd_watch_screen_time, 0, sizeof(fd_watch_screen_time));
    
    fd_drawing_plane_t *plane = &fd_watch_screen_time.plane;
    plane->drawings = fd_watch_screen_time.drawings;
    screen->planes[0] = plane;
    screen->plane_count = 1;
    screen->preview = fd_watch_screen_time_preview;
    screen->activate = fd_watch_screen_time_activate;
    screen->deactivate = fd_watch_screen_time_deactivate;
    screen->button = fd_watch_screen_time_button;
    screen->animate = fd_watch_screen_time_animate;
    
    fd_watch_screen_time.text.view = (fd_view_text_t) {
        .visible = true,
        .location = { .x = 64, .y = 64 },
        .alignments = { .x = fd_view_alignment_center, .y = fd_view_alignment_center },
        .string = { .string = fd_watch_screen_time.time_string, .size = sizeof(fd_watch_screen_time.time_string) },
        .font.font = &fd_font_b612_regular_6,
        .color = { .argb = 0xffffffff },
    };
    fd_watch_screen_time_add_drawing(&fd_watch_screen_time.text, &fd_drawing_text_class);
    
    fd_watch_screen_time_update();
}
```
